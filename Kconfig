## Kconfig
```kconfig
menu "ESP CherryUSB"
    visible if IDF_TARGET_ESP32S2 || IDF_TARGET_ESP32S3

    # Invisible item, enabled when USB_OTG peripheral does exist
    config CHERRYUSB_SUPPORTED
        bool
        default y if IDF_TARGET_ESP32S2 || IDF_TARGET_ESP32S3

    menuconfig CHERRYUSBD_ENABLED
        bool "Enable CherryUSB Device"
        depends on CHERRYUSB_SUPPORTED
        default n
        help
            Enable CherryUSB Device support.
        if CHERRYUSBD_ENABLED
            config USBDEV_REQUEST_BUFFER_LEN
                int "Largest size (in bytes) of transfers to ep0 out"
                default 512
            config USBDEV_SETUP_LOG_PRINT
                bool "Print USB setup packet"
                default n
            config USBDEV_DESC_CHECK
                bool "Check USB descriptor"
                default n
            config USBDEV_TEST_MODE
                bool "USB test mode"
                default n
        endif # CHERRYUSBD_ENABLED

    menu "USB Device Config"
        visible if CHERRYUSBD_ENABLED

        menu "USB Device CDC ACM Config"
        endmenu

        menu "USB Device HID Config"
        endmenu

        menu "USB Device MSC Config"
            config USBDEV_MSC_MAX_BUFSIZE
                int "Block size of MSC device"
                default 512
            config USBDEV_MSC_MANUFACTURER_STRING
                string "Manufacturer string"
                default "Espressif"
            config USBDEV_MSC_PRODUCT_STRING
                string "Product string"
                default "ESP-MSC"
            config USBDEV_MSC_VERSION_STRING
                string "Version string"
                default "0.01"
            config USBDEV_MSC_THREAD
                bool "Enable MSC thread"
                default y
            config USBDEV_MSC_PRIO
                int "Priority of the MSC thread"
                depends on USBDEV_MSC_THREAD
                default 4
            config USBDEV_MSC_STACKSIZE
                int "Stack size of the MSC thread"
                depends on USBDEV_MSC_THREAD
                default 3096
        endmenu

        menu "USB Device Audio Config"
        endmenu

        menu "USB Device Video Config"
        endmenu

        menu "USB Device CDC RNDIS Config"
            config USBDEV_RNDIS_RESP_BUFFER_SIZE
                int "RNDIS response buffer size"
                default 156
            config USBDEV_RNDIS_ETH_MAX_FRAME_SIZE
                int "Maximum frame size"
                default 1580
            config USBDEV_RNDIS_VENDOR_ID
                hex "Vendor ID"
                default 0x0000ffff
            config USBDEV_RNDIS_VENDOR_DESC
                string "Vendor description"
                default "Espressif"
            config USBDEV_RNDIS_USING_LWIP
                bool "Using LWIP"
                default y
        endmenu

        menu "USB Device CDC ECM Config"
        endmenu

        menu "USB Device DFU Config"
        endmenu

    endmenu

    menuconfig CHERRYUSBH_ENABLED
        bool "Enable CherryUSB Host"
        depends on CHERRYUSB_SUPPORTED
        default n
        help
            Enable CherryUSB Host support.
        if CHERRYUSBH_ENABLED
            config USBHOST_MAX_RHPORTS
                int "Maximum number of root hub ports"
                default 1
            config USBHOST_MAX_EXTHUBS
                int "Maximum number of external hubs"
                default 1
            config USBHOST_MAX_EHPORTS
                int "Maximum number of external hub ports"
                default 4
            config USBHOST_MAX_INTERFACES
                int "Maximum number of interfaces"
                default 8
            config USBHOST_MAX_INTF_ALTSETTINGS
                int "Maximum number of interface alternate settings"
                default 8
            config USBHOST_MAX_ENDPOINTS
                int "Maximum number of endpoints"
                default 4
            config USBHOST_DEV_NAMELEN
                int "Maximum length of device name"
                default 16
            config USBHOST_PSC_PRIO
                int "Priority of the Host PSC task"
                range 1 25
                default 1
            config USBHOST_PSC_STACKSIZE
                int "Stack size of the Host PSC task"
                default 2048
            config USBHOST_GET_STRING_DESC
                bool "Get string descriptor"
                default n
            config USBHOST_MSOS_ENABLE
                bool "Msos enable"
                default n
            config USBHOST_MSOS_VENDOR_CODE
                hex "Msos vendor code"
                depends on USBHOST_MSOS_ENABLE
                range 0x00 0xff
                default 0x00
            config USBHOST_REQUEST_BUFFER_LEN
                int "Largest size (in bytes) of transfers from/to ep0"
                default 512
            config USBHOST_CONTROL_TRANSFER_TIMEOUT
                int "Timeout for control transfers (in ms)"
                default 500
            config USBHOST_MSC_TIMEOUT
                int "Timeout for MSC (in ms)"
                default 5000
        endif # CHERRYUSBH_ENABLED

    menu "USB Host driver Config"
        visible if CHERRYUSBH_ENABLED

        config CHERRYUSBH_CDC_ACM_ENABLED
            bool "Enable CDC ACM driver"
            default n
        config USBHOST_MAX_CDC_ACM_CLASS
            int "Maximum number of CDC ACM class devices"
            depends on CHERRYUSBH_CDC_ACM_ENABLED
            default 1
        config CHERRYUSBH_HID_ENABLED
            bool "Enable HID driver"
            default n
        config USBHOST_MAX_HID_CLASS
            int "Maximum number of HID class devices"
            depends on CHERRYUSBH_HID_ENABLED
            default 3
        config CHERRYUSBH_MSC_ENABLED
            bool "Enable MSC driver"
            default n
        config USBHOST_MAX_MSC_CLASS
            depends on CHERRYUSBH_MSC_ENABLED
            int "Maximum number of MSC class devices"
            default 1
        config CHERRYUSBH_CDC_ECM_ENABLED
            bool "Enable CDC ECM driver"
            default n
        config CHERRYUSBH_CDC_RNDIS_ENABLED
            bool "Enable RNDIS driver"
            default n
        config CHERRYUSBH_CDC_NCM_ENABLED
            bool "Enable CDC NCM driver"
            default n
        config CHERRYUSBH_VIDEO_ENABLED
            bool "Enable Video driver"
            default n
        config USBHOST_MAX_VIDEO_CLASS
            int "Maximum number of Video class devices"
            depends on CHERRYUSBH_VIDEO_ENABLED
            default 1
        config CHERRYUSBH_AUDIO_ENABLED
            bool "Enable Audio driver"
            default n
        config USBHOST_MAX_AUDIO_CLASS
            int "Maximum number of Audio class devices"
            depends on CHERRYUSBH_AUDIO_ENABLED
            default 1
        config CHERRYUSBH_BLUETOOTH_ENABLED
            bool "Enable Bluetooth driver"
            default n
        config CHERRYUSBH_ASIX_ENABLED
            bool "Enable ASIX driver"
            default n
        config CHERRYUSBH_RTL8152_ENABLED
            bool "Enable RTL8152 driver"
            default n
        config CHERRYUSBH_FTDI
            bool "Enable FTDI driver"
            default n
        config CHERRYUSBH_CH34X
            bool "Enable CH34x driver"
            default n
        config CHERRYUSBH_CP210X
            bool "Enable CP210X driver"
            default n
        config CHERRYUSBH_PL2303
            bool "Enable PL2303 driver"
            default n
    endmenu

endmenu #ESP CherryUSB
```
